## templeos-riscv/configs/virt_defconfig
```kconfig
# Default: QEMU virt (CI / all kernel-*-smoke)
CONFIG_PLATFORM_VIRT=y
# CONFIG_PLATFORM_SIFIVE_U is not set
# CONFIG_PLATFORM_SIFIVE_E is not set
# CONFIG_PLATFORM_SPIKE is not set
# CONFIG_PLATFORM_SHAKTI_C is not set
# CONFIG_PLATFORM_MICROCHIP_ICICLE is not set
# CONFIG_PLATFORM_XIANGSHAN is not set
# CONFIG_PLATFORM_AMD_MICROBLAZE_V is not set
# CONFIG_PLATFORM_OPENTITAN is not set
# CONFIG_PLATFORM_HOST is not set
# CONFIG_PLATFORM_CUSTOM is not set
CONFIG_UART_16550=y
# CONFIG_UART_SIFIVE is not set
# CONFIG_UART_HTIF is not set
# CONFIG_UART_STUB is not set
CONFIG_HAS_PLIC=y
CONFIG_HAS_VIRTIO_MMIO=y
CONFIG_HAS_VIRTIO_PCI=y
CONFIG_HAS_FW_CFG=y
CONFIG_HAS_GOLDFISH_RTC=y
CONFIG_FB_PRESENT_RAMFB=y
# CONFIG_FB_PRESENT_SIMPLEFB is not set
# CONFIG_FB_PRESENT_NONE is not set
CONFIG_EDITOR_VI=y
# CONFIG_EDITOR_EDIT is not set
# CONFIG_EDITOR_ED is not set
CONFIG_OUTPUT_FORMAT_ELF=y
# CONFIG_OUTPUT_FORMAT_FIRMWARE is not set
```
